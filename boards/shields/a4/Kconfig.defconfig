## boards/shields/a4/Kconfig.defconfig
```kconfig
if SHIELD_A4_RIGHT

config ZMK_KEYBOARD_NAME
    default "a4"

endif

if SHIELD_A4_LEFT || SHIELD_A4_RIGHT

config ZMK_SPLIT
    default y

endif
```

## boards/shields/a4/Kconfig.shield
```kconfig
config SHIELD_A4_LEFT
    def_bool $(shields_list_contains,a4_left)
config SHIELD_A4_RIGHT
    def_bool $(shields_list_contains,a4_right)
```
